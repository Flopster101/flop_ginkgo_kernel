&soc {
	goodix_fp {
		compatible = "goodix,fingerprint";
		interrupt-parent = <&tlmm>;
		interrupt = <92 0x0>;
		vcc_spi-supply = <&pm6125_l9>;
		vcc_ana-supply = <&pm6125_l9>;
		vdd_io-supply = <&pm6125_l9>;
		fp-gpio-irq = <&tlmm 92 0x00>;
		fp-gpio-reset = <&tlmm 93 0x00>;
		status = "okay";
	};

	fpc1020 {
		status = "ok";
		compatible = "fpc,fpc1020";
		interrupt-parent = <&tlmm>;
		interrupts = <92 0x0>;
		fpc,gpio_rst    = <&tlmm 93 0x0>;
		fpc,gpio_irq    = <&tlmm 92 0x0>;
		vcc_spi-supply  = <&pm6125_l9>;
		vdd_io-supply   = <&pm6125_l9>;
		vdd_ana-supply  = <&pm6125_l9>;

		pinctrl-names = "fpc1020_reset_reset",
			"fpc1020_reset_active",
			"fpc1020_irq_active";

		pinctrl-0 = <&msm_gpio_93>;
		pinctrl-1 = <&msm_gpio_93_output_high>;
		pinctrl-2 = <&msm_gpio_92>;
	};
};