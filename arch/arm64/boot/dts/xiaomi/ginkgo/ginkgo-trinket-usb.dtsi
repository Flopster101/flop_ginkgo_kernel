&usb0{
	dwc3@4e00000 {
		usb-phy = <&qusb_phy0>, <&usb_nop_phy>;
		maximum-speed = "high-speed";
	};
};

&qusb_phy0 {
	qcom,qusb-phy-init-seq-no-panel = <0xf8 0x80
					0xe3 0x84
					0x81 0x88
					0xc0 0x8c
					0x30 0x08
					0x79 0x0c
					0x21 0x10
					0x14 0x9c
					0x80 0x04
					0x9f 0x1c
					0x00 0x18>;
};

&usb_qmp_phy {
	status = "disabled";
};
